''' Convenience include for beginner experiments.
#include "boards/redboard/rb_board_redboard.inc"
#include "common/rb_status.inc"
#include "gpio/rb_gpio.inc"
#include "gpio/rb_led.inc"
#include "gpio/rb_switch.inc"
#include "timing/rb_stopwatch.inc"
#include "timing/rb_scheduler.inc"
#include "analog/rb_adc.inc"
#include "analog/rb_pwm_softdac.inc"
#include "comms/rb_uart.inc"
#include "comms/rb_gsa_text.inc"
#include "data/rb_csv.inc"
#include "data/rb_keyvalue.inc"
#include "diagnostics/rb_faults.inc"
#include "diagnostics/rb_selftest.inc"
#include "devices/rb_hx711.inc"
#include "devices/rb_hcsr04.inc"
#include "devices/rb_ds18b20.inc"
#include "devices/rb_rgb_show.inc"
