;'Program compiled by GCBASIC (2025.10.04 (Windows 64 bit) : Build 1523) for Microchip PIC-AS using FreeBASIC 1.07.1/2025-10-03 CRC248
;'  Please donate to help support the operational costs of the project.  Donate via https://gcbasic.com/donate/
;'  
;'  See the GCBASIC forums at http://sourceforge.net/projects/gcbasic/forums,
;'  Check the documentation and Help at http://gcbasic.sourceforge.net/help/,
;'or, email:
;'   evanvennn at users dot sourceforge dot net
;'********************************************************************************
;'   Installation Dir : C:\GCstudio\gcbasic
;'   Source file      : C:\Users\rasyoung\Desktop\nugget-fwlib\examples\016_tare_button_pattern\016_tare_button_pattern.gcb
;'   Setting file     : C:\GCstudio\gcbasic\use.ini
;'   Preserve mode    : 0
;'   Assembler        : "C:\Program Files\Microchip\xc8\v2.36\pic-as\bin\pic-as.exe"
;'   Programmer       : 
;'   Output file      : C:\Users\rasyoung\Desktop\nugget-fwlib\examples\016_tare_button_pattern\016_tare_button_pattern.asm
;'   Float Capability : 0
;'********************************************************************************

;'Set up the assembler options (Chip type, clock source, other bits and pieces)
;'PROCESSOR   16F18424
 PAGEWIDTH   180
 RADIX       DEC
 TITLE       "C:\Users\rasyoung\Desktop\nugget-fwlib\examples\016_tare_button_pattern\016_tare_button_pattern.gcb"
 SUBTITLE    "05-24-2026 17:01:03"

;' Reverse lookup file(s)
;' C:\Users\rasyoung\.mchp_packs\Microchip\PIC16F1xxxx_DFP\1.31.465\xc8\pic\include\proc\pic16f18424.inc
;' C:\Program Files\Microchip\xc8\v2.36\pic\dat\cfgdata\16f18424.cfgdata

;'********************************************************************************

;'********************************************************************************
;'Explicit CONFIG
 CONFIG FCMEN=ON                                 ;C1 Reverselookup FCMEN = ON
 CONFIG CLKOUTEN=OFF                             ;C1 Reverselookup CLKOUTEN = OFF
 CONFIG RSTOSC=HFINT32                           ;C1 Reverselookup RSTOSC = HFINT32
 CONFIG FEXTOSC=OFF                              ;C1 Reverselookup FEXTOSC = OFF
 CONFIG MCLRE=ON                                 ;C1 Reverselookup MCLRE = ON
 CONFIG WDTE=OFF                                 ;C1 Reverselookup WDTE = OFF
 CONFIG LVP=ON                                   ;C1 Reverselookup LVP = ON
 CONFIG WRTSAF=OFF                               ;C1 Reverselookup WRTSAF = OFF
 CONFIG WRTD=OFF                                 ;C1 Reverselookup WRTD = OFF
 CONFIG WRTB=OFF                                 ;C1 Reverselookup WRTB = OFF
 CONFIG CP=OFF                                   ;C1 Reverselookup CP = OFF
;'Inferred CONFIG


;'********************************************************************************
;' The XC8 xc.inc include file.  This MUST be placed after the CONFIG statements.

 #include <xc.inc>

;'********************************************************************************

;'Set aside RAM memory locations for variables. All variables are global.
 COMPORT                          EQU 32          ; 0X20
 DELAYTEMP                        EQU 112          ; 0X70 (SA)
 DELAYTEMP2                       EQU 113          ; 0X71 (SA)
 HSERPRINTCRLFCOUNT               EQU 33          ; 0X21
 PRINTLEN                         EQU 34          ; 0X22
 SERDATA                          EQU 35          ; 0X23
 SERPRINTVAL                      EQU 36          ; 0X24
 SERPRINTVAL_E                    EQU 39          ; 0X27
 SERPRINTVAL_H                    EQU 37          ; 0X25
 SERPRINTVAL_U                    EQU 38          ; 0X26
 STRINGPOINTER                    EQU 40          ; 0X28
 SYSBITVAR0                       EQU 41          ; 0X29
 SYSBYTETEMPX                     EQU 112          ; 0X70 (SA)
 SYSCALCTEMPA                     EQU 117          ; 0X75 (SA)
 SYSCALCTEMPA_E                   EQU 120          ; 0X78 (SA)
 SYSCALCTEMPA_H                   EQU 118          ; 0X76 (SA)
 SYSCALCTEMPA_U                   EQU 119          ; 0X77 (SA)
 SYSDIVLOOP                       EQU 116          ; 0X74 (SA)
 SYSLONGDIVMULTA                  EQU 42          ; 0X2A
 SYSLONGDIVMULTA_E                EQU 45          ; 0X2D
 SYSLONGDIVMULTA_H                EQU 43          ; 0X2B
 SYSLONGDIVMULTA_U                EQU 44          ; 0X2C
 SYSLONGDIVMULTB                  EQU 46          ; 0X2E
 SYSLONGDIVMULTB_E                EQU 49          ; 0X31
 SYSLONGDIVMULTB_H                EQU 47          ; 0X2F
 SYSLONGDIVMULTB_U                EQU 48          ; 0X30
 SYSLONGDIVMULTX                  EQU 50          ; 0X32
 SYSLONGDIVMULTX_E                EQU 53          ; 0X35
 SYSLONGDIVMULTX_H                EQU 51          ; 0X33
 SYSLONGDIVMULTX_U                EQU 52          ; 0X34
 SYSLONGTEMPA                     EQU 117          ; 0X75 (SA)
 SYSLONGTEMPA_E                   EQU 120          ; 0X78 (SA)
 SYSLONGTEMPA_H                   EQU 118          ; 0X76 (SA)
 SYSLONGTEMPA_U                   EQU 119          ; 0X77 (SA)
 SYSLONGTEMPB                     EQU 121          ; 0X79 (SA)
 SYSLONGTEMPB_E                   EQU 124          ; 0X7C (SA)
 SYSLONGTEMPB_H                   EQU 122          ; 0X7A (SA)
 SYSLONGTEMPB_U                   EQU 123          ; 0X7B (SA)
 SYSLONGTEMPX                     EQU 112          ; 0X70 (SA)
 SYSLONGTEMPX_E                   EQU 115          ; 0X73 (SA)
 SYSLONGTEMPX_H                   EQU 113          ; 0X71 (SA)
 SYSLONGTEMPX_U                   EQU 114          ; 0X72 (SA)
 SYSPRINTBUFFER                   EQU 8677          ; 0X21E5
 SYSPRINTBUFFLEN                  EQU 54          ; 0X36
 SYSPRINTDATAHANDLER              EQU 55          ; 0X37
 SYSPRINTDATAHANDLER_H            EQU 56          ; 0X38
 SYSPRINTTEMP                     EQU 57          ; 0X39
 SYSREPEATTEMP1                   EQU 58          ; 0X3A
 SYSSTRINGA                       EQU 119          ; 0X77 (SA)
 SYSSTRINGA_H                     EQU 120          ; 0X78 (SA)
 SYSTEMP1                         EQU 59          ; 0X3B
 SYSTEMP1_E                       EQU 62          ; 0X3E
 SYSTEMP1_H                       EQU 60          ; 0X3C
 SYSTEMP1_U                       EQU 61          ; 0X3D
 SYSWAITTEMPMS                    EQU 114          ; 0X72 (SA)
 SYSWAITTEMPMS_H                  EQU 115          ; 0X73 (SA)
 TARECOUNT                        EQU 63          ; 0X3F
 TARECOUNT_E                      EQU 66          ; 0X42
 TARECOUNT_H                      EQU 64          ; 0X40
 TARECOUNT_U                      EQU 65          ; 0X41

;'********************************************************************************

;'ALIAS VARIABLES
 AFSR0                            EQU 4
 AFSR0_H                          EQU 5

;'********************************************************************************

 PSECT   PROGMEM0,delta=2, abs
 RESETVEC:
;'VECTORS
	ORG	0
	PAGESEL	BASPROGRAMSTART
	GOTO	BASPROGRAMSTART
	ORG	4
	RETFIE

;'********************************************************************************

;'PROGRAM_MEMORY_PAGE: 0
	ORG	5
BASPROGRAMSTART:
;'CALL INITIALISATION ROUTINES
	CALL	INITSYS
	CALL	INITUSART

;'START_OF_THE_MAIN_PROGRAM
	CALL	RB_BOARD_INIT
	CALL	RB_SW1_INITPULLUP
	CALL	RB_LED_STATUS_INIT
	CLRF	TARECOUNT
	CLRF	TARECOUNT_H
	CLRF	TARECOUNT_U
	CLRF	TARECOUNT_E
SYSDOLOOP_S1:
	CALL	FN_RB_SW1_PRESSEDEVENT
	BTFSS	SYSBITVAR0,5
	GOTO	ENDIF1
	INCF	TARECOUNT,F
	BTFSC	STATUS,2
	INCF	TARECOUNT_H,F
	BTFSC	STATUS,2
	INCF	TARECOUNT_U,F
	BTFSC	STATUS,2
	INCF	TARECOUNT_E,F
	MOVLW	LOW STRINGTABLE2
	MOVWF	SYSPRINTDATAHANDLER
	MOVLW	(HIGH STRINGTABLE2) | 128
	MOVWF	SYSPRINTDATAHANDLER_H
	MOVLW	1
	MOVWF	COMPORT
	CALL	HSERPRINT437
	MOVF	TARECOUNT,W
	MOVWF	SERPRINTVAL
	MOVF	TARECOUNT_H,W
	MOVWF	SERPRINTVAL_H
	MOVF	TARECOUNT_U,W
	MOVWF	SERPRINTVAL_U
	MOVF	TARECOUNT_E,W
	MOVWF	SERPRINTVAL_E
	MOVLW	1
	MOVWF	COMPORT
	CALL	HSERPRINT442
	MOVLW	1
	MOVWF	HSERPRINTCRLFCOUNT
	MOVLW	1
	MOVWF	COMPORT
	CALL	HSERPRINTCRLF
	CALL	RB_LED_STATUS_PULSE100
ENDIF1:
	GOTO	SYSDOLOOP_S1
SYSDOLOOP_E1:
BASPROGRAMEND:
	SLEEP
	GOTO	BASPROGRAMEND

;'********************************************************************************

DELAY_MS:
	INCF	SYSWAITTEMPMS_H, F
DMS_START:
	MOVLW	14
	MOVWF	DELAYTEMP2
DMS_OUTER:
	MOVLW	189
	MOVWF	DELAYTEMP
DMS_INNER:
	DECFSZ	DELAYTEMP, F
	GOTO	DMS_INNER
	DECFSZ	DELAYTEMP2, F
	GOTO	DMS_OUTER
	DECFSZ	SYSWAITTEMPMS, F
	GOTO	DMS_START
	DECFSZ	SYSWAITTEMPMS_H, F
	GOTO	DMS_START
	RETURN

;'********************************************************************************

HSERPRINT437:
	MOVF	SYSPRINTDATAHANDLER,W
	MOVWF	FSR0L
	MOVF	SYSPRINTDATAHANDLER_H,W
	MOVWF	FSR0H
	MOVF	INDF0,W
	MOVWF	PRINTLEN
	MOVF	PRINTLEN,F
	BTFSC	STATUS,2
	GOTO	ENDIF7
	CLRF	SYSPRINTTEMP
	MOVLW	1
	SUBWF	PRINTLEN,W
	BTFSS	STATUS,0
	GOTO	SYSFORLOOPEND1
SYSFORLOOP1:
	INCF	SYSPRINTTEMP,F
	MOVF	SYSPRINTTEMP,W
	ADDWF	SYSPRINTDATAHANDLER,W
	MOVWF	FSR0L
	MOVLW	0
	ADDWFC	SYSPRINTDATAHANDLER_H,W
	MOVWF	FSR0H
	MOVF	INDF0,W
	MOVWF	SERDATA
	CALL	HSERSEND425
	MOVF	PRINTLEN,W
	SUBWF	SYSPRINTTEMP,W
	BTFSS	STATUS,0
	GOTO	SYSFORLOOP1
SYSFORLOOPEND1:
ENDIF7:
	RETURN

;'********************************************************************************

HSERPRINT442:
	CLRF	SYSPRINTBUFFLEN
SYSDOLOOP_S2:
	INCF	SYSPRINTBUFFLEN,F
	MOVLW	LOW(SYSPRINTBUFFER)
	ADDWF	SYSPRINTBUFFLEN,W
	MOVWF	FSR0L
	CLRF	SYSTEMP1
	MOVLW	HIGH(SYSPRINTBUFFER)
	ADDWFC	SYSTEMP1,W
	MOVWF	FSR0H
	MOVF	SERPRINTVAL,W
	MOVWF	SYSLONGTEMPA
	MOVF	SERPRINTVAL_H,W
	MOVWF	SYSLONGTEMPA_H
	MOVF	SERPRINTVAL_U,W
	MOVWF	SYSLONGTEMPA_U
	MOVF	SERPRINTVAL_E,W
	MOVWF	SYSLONGTEMPA_E
	MOVLW	10
	MOVWF	SYSLONGTEMPB
	CLRF	SYSLONGTEMPB_H
	CLRF	SYSLONGTEMPB_U
	CLRF	SYSLONGTEMPB_E
	CALL	SYSDIVSUB32
	MOVF	SYSLONGTEMPX,W
	MOVWF	INDF0
	MOVF	SYSCALCTEMPA,W
	MOVWF	SERPRINTVAL
	MOVF	SYSCALCTEMPA_H,W
	MOVWF	SERPRINTVAL_H
	MOVF	SYSCALCTEMPA_U,W
	MOVWF	SERPRINTVAL_U
	MOVF	SYSCALCTEMPA_E,W
	MOVWF	SERPRINTVAL_E
	MOVF	SERPRINTVAL,W
	MOVWF	SYSLONGTEMPA
	MOVF	SERPRINTVAL_H,W
	MOVWF	SYSLONGTEMPA_H
	MOVF	SERPRINTVAL_U,W
	MOVWF	SYSLONGTEMPA_U
	MOVF	SERPRINTVAL_E,W
	MOVWF	SYSLONGTEMPA_E
	CLRF	SYSLONGTEMPB
	CLRF	SYSLONGTEMPB_H
	CLRF	SYSLONGTEMPB_U
	CLRF	SYSLONGTEMPB_E
	CALL	SYSCOMPEQUAL32
	COMF	SYSBYTETEMPX,F
	BTFSC	SYSBYTETEMPX,0
	GOTO	SYSDOLOOP_S2
SYSDOLOOP_E2:
	INCF	SYSPRINTBUFFLEN,W
	MOVWF	SYSPRINTTEMP
	MOVLW	1
	SUBWF	SYSPRINTBUFFLEN,W
	BTFSS	STATUS,0
	GOTO	SYSFORLOOPEND2
SYSFORLOOP2:
	DECF	SYSPRINTTEMP,F
	MOVLW	LOW(SYSPRINTBUFFER)
	ADDWF	SYSPRINTTEMP,W
	MOVWF	FSR0L
	CLRF	SYSTEMP1
	MOVLW	HIGH(SYSPRINTBUFFER)
	ADDWFC	SYSTEMP1,W
	MOVWF	FSR0H
	MOVLW	48
	ADDWF	INDF0,W
	MOVWF	SERDATA
	CALL	HSERSEND425
	MOVF	SYSPRINTTEMP,W
	SUBLW	1
	BTFSS	STATUS,0
	GOTO	SYSFORLOOP2
SYSFORLOOPEND2:
	RETURN

;'********************************************************************************

HSERPRINTCRLF:
	MOVF	HSERPRINTCRLFCOUNT,W
	MOVWF	SYSREPEATTEMP1
	BTFSC	STATUS,2
	GOTO	SYSREPEATLOOPEND1
SYSREPEATLOOP1:
	MOVLW	13
	MOVWF	SERDATA
	CALL	HSERSEND425
	MOVLW	10
	MOVWF	SERDATA
	CALL	HSERSEND425
	DECFSZ	SYSREPEATTEMP1,F
	GOTO	SYSREPEATLOOP1
SYSREPEATLOOPEND1:
	RETURN

;'********************************************************************************

HSERSEND425:
HSERSENDUSART1HANDLER:
	MOVF	SERDATA,W
	BANKSEL	TX1REG
	MOVWF	TX1REG
	MOVLW	1
	MOVWF	SYSWAITTEMPMS
	CLRF	SYSWAITTEMPMS_H
	BANKSEL	STATUS
	GOTO	DELAY_MS

;'********************************************************************************

INITSYS:
;'DEFAULT SETTINGS FOR MICROCONTROLLERS WITH _OSCCON1_
	MOVLW	96
	BANKSEL	OSCCON1
	MOVWF	OSCCON1
	CLRF	OSCCON3
	CLRF	OSCEN
	CLRF	OSCTUNE
;'THE MCU IS A CHIP FAMILY CHIPFAMILY
;'OSCCON TYPE IS 102
	MOVLW	6
	MOVWF	OSCFRQ
;'_COMPLETE_THE_CHIP_SETUP_OF_BSR_ADCS_ANSEL_AND_OTHER_KEY_SETUP_REGISTERS_OR_REGISTER_BITS
	BANKSEL	ADCON0
	BCF	ADCON0,2
	BCF	ADCON0,7
	BANKSEL	ANSELA
	CLRF	ANSELA
	CLRF	ANSELC
	BANKSEL	CM2CON0
	BCF	CM2CON0,7
	BCF	CM1CON0,7
	BANKSEL	PORTA
	CLRF	PORTA
	CLRF	PORTC
	RETURN

;'********************************************************************************

INITUSART:
	MOVLW	3
	BANKSEL	SP1BRGH
	MOVWF	SP1BRGH
	MOVLW	64
	MOVWF	SP1BRGL
	MOVLW	64
	MOVWF	SP1BRGL
	BSF	BAUD1CON,3
	BSF	TX1STA,2
	BCF	TX1STA,4
	BSF	TX1STA,5
	BSF	RC1STA,7
	BSF	RC1STA,4
	BSF	RC1STA,4
	BANKSEL	STATUS
	RETURN

;'********************************************************************************

RB_BOARD_INIT:
	GOTO	RB_CORE_INIT

;'********************************************************************************

RB_CORE_ALLDIGITAL:
	BANKSEL	ANSELA
	CLRF	ANSELA
	CLRF	ANSELC
	BANKSEL	STATUS
	RETURN

;'********************************************************************************

RB_CORE_CLEARLATCHES:
	CLRF	LATA
	CLRF	LATC
	RETURN

;'********************************************************************************

RB_CORE_INIT:
	CALL	RB_CORE_ALLDIGITAL
	GOTO	RB_CORE_CLEARLATCHES

;'********************************************************************************

RB_LED_STATUS_INIT:
	BCF	TRISC,0
	BANKSEL	ANSELC
	BCF	ANSELC,0
	BANKSEL	LATC
	BCF	LATC,0
	RETURN

;'********************************************************************************

RB_LED_STATUS_PULSE100:
	BSF	LATC,0
	MOVLW	100
	MOVWF	SYSWAITTEMPMS
	CLRF	SYSWAITTEMPMS_H
	CALL	DELAY_MS
	BCF	LATC,0
	RETURN

;'********************************************************************************

RB_SW1_INITPULLUP:
	BSF	TRISA,0
	BANKSEL	ANSELA
	BCF	ANSELA,0
	BSF	WPUA,0
	BANKSEL	SYSBITVAR0
	BCF	SYSBITVAR0,0
	BTFSC	PORTA,0
	BSF	SYSBITVAR0,0
	BCF	SYSBITVAR0,1
	RETURN

;'********************************************************************************

FN_RB_SW1_PRESSEDEVENT:
	BCF	SYSBITVAR0,5
	BTFSS	SYSBITVAR0,0
	GOTO	ENDIF3
	BTFSC	PORTA,0
	GOTO	ENDIF4
	MOVLW	20
	MOVWF	SYSWAITTEMPMS
	CLRF	SYSWAITTEMPMS_H
	CALL	DELAY_MS
	BTFSS	PORTA,0
	BSF	SYSBITVAR0,5
ENDIF4:
ENDIF3:
	BCF	SYSBITVAR0,0
	BTFSC	PORTA,0
	BSF	SYSBITVAR0,0
	RETURN

;'********************************************************************************

SYSCOMPEQUAL32:
	CLRF	SYSBYTETEMPX
	MOVF	SYSLONGTEMPA, W
	SUBWF	SYSLONGTEMPB, W
	BTFSS	STATUS,2
	RETURN
	MOVF	SYSLONGTEMPA_H, W
	SUBWF	SYSLONGTEMPB_H, W
	BTFSS	STATUS,2
	RETURN
	MOVF	SYSLONGTEMPA_U, W
	SUBWF	SYSLONGTEMPB_U, W
	BTFSS	STATUS,2
	RETURN
	MOVF	SYSLONGTEMPA_E, W
	SUBWF	SYSLONGTEMPB_E, W
	BTFSS	STATUS,2
	RETURN
	COMF	SYSBYTETEMPX,F
	RETURN

;'********************************************************************************

SYSDIVSUB32:
	MOVF	SYSLONGTEMPA,W
	MOVWF	SYSLONGDIVMULTA
	MOVF	SYSLONGTEMPA_H,W
	MOVWF	SYSLONGDIVMULTA_H
	MOVF	SYSLONGTEMPA_U,W
	MOVWF	SYSLONGDIVMULTA_U
	MOVF	SYSLONGTEMPA_E,W
	MOVWF	SYSLONGDIVMULTA_E
	MOVF	SYSLONGTEMPB,W
	MOVWF	SYSLONGDIVMULTB
	MOVF	SYSLONGTEMPB_H,W
	MOVWF	SYSLONGDIVMULTB_H
	MOVF	SYSLONGTEMPB_U,W
	MOVWF	SYSLONGDIVMULTB_U
	MOVF	SYSLONGTEMPB_E,W
	MOVWF	SYSLONGDIVMULTB_E
	CLRF	SYSLONGDIVMULTX
	CLRF	SYSLONGDIVMULTX_H
	CLRF	SYSLONGDIVMULTX_U
	CLRF	SYSLONGDIVMULTX_E
	MOVF	SYSLONGDIVMULTB,W
	MOVWF	SYSLONGTEMPA
	MOVF	SYSLONGDIVMULTB_H,W
	MOVWF	SYSLONGTEMPA_H
	MOVF	SYSLONGDIVMULTB_U,W
	MOVWF	SYSLONGTEMPA_U
	MOVF	SYSLONGDIVMULTB_E,W
	MOVWF	SYSLONGTEMPA_E
	CLRF	SYSLONGTEMPB
	CLRF	SYSLONGTEMPB_H
	CLRF	SYSLONGTEMPB_U
	CLRF	SYSLONGTEMPB_E
	CALL	SYSCOMPEQUAL32
	BTFSS	SYSBYTETEMPX,0
	GOTO	ENDIF12
	CLRF	SYSLONGTEMPA
	CLRF	SYSLONGTEMPA_H
	CLRF	SYSLONGTEMPA_U
	CLRF	SYSLONGTEMPA_E
	RETURN
ENDIF12:
	MOVLW	32
	MOVWF	SYSDIVLOOP
SYSDIV32START:
	BCF	STATUS,0
	RLF	SYSLONGDIVMULTA,F
	RLF	SYSLONGDIVMULTA_H,F
	RLF	SYSLONGDIVMULTA_U,F
	RLF	SYSLONGDIVMULTA_E,F
	RLF	SYSLONGDIVMULTX,F
	RLF	SYSLONGDIVMULTX_H,F
	RLF	SYSLONGDIVMULTX_U,F
	RLF	SYSLONGDIVMULTX_E,F
	MOVF	SYSLONGDIVMULTB,W
	SUBWF	SYSLONGDIVMULTX,F
	MOVF	SYSLONGDIVMULTB_H,W
	SUBWFB	SYSLONGDIVMULTX_H,F
	MOVF	SYSLONGDIVMULTB_U,W
	SUBWFB	SYSLONGDIVMULTX_U,F
	MOVF	SYSLONGDIVMULTB_E,W
	SUBWFB	SYSLONGDIVMULTX_E,F
	BSF	SYSLONGDIVMULTA,0
	BTFSC	STATUS,0
	GOTO	ENDIF13
	BCF	SYSLONGDIVMULTA,0
	MOVF	SYSLONGDIVMULTB,W
	ADDWF	SYSLONGDIVMULTX,F
	MOVF	SYSLONGDIVMULTB_H,W
	ADDWFC	SYSLONGDIVMULTX_H,F
	MOVF	SYSLONGDIVMULTB_U,W
	ADDWFC	SYSLONGDIVMULTX_U,F
	MOVF	SYSLONGDIVMULTB_E,W
	ADDWFC	SYSLONGDIVMULTX_E,F
ENDIF13:
	DECFSZ	SYSDIVLOOP, F
	GOTO	SYSDIV32START
	MOVF	SYSLONGDIVMULTA,W
	MOVWF	SYSLONGTEMPA
	MOVF	SYSLONGDIVMULTA_H,W
	MOVWF	SYSLONGTEMPA_H
	MOVF	SYSLONGDIVMULTA_U,W
	MOVWF	SYSLONGTEMPA_U
	MOVF	SYSLONGDIVMULTA_E,W
	MOVWF	SYSLONGTEMPA_E
	MOVF	SYSLONGDIVMULTX,W
	MOVWF	SYSLONGTEMPX
	MOVF	SYSLONGDIVMULTX_H,W
	MOVWF	SYSLONGTEMPX_H
	MOVF	SYSLONGDIVMULTX_U,W
	MOVWF	SYSLONGTEMPX_U
	MOVF	SYSLONGDIVMULTX_E,W
	MOVWF	SYSLONGTEMPX_E
	RETURN

;'********************************************************************************

SYSSTRINGTABLES:
	MOVF	SYSSTRINGA_H,W
	MOVWF	PCLATH
	MOVF	SYSSTRINGA,W
	INCF	SYSSTRINGA,F
	BTFSC	STATUS,2
	INCF	SYSSTRINGA_H,F
	MOVWF	PCL

STRINGTABLE2:
	RETLW	20
	RETLW	79	;O
	RETLW	75	;K
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	RETLW	32	; 


;'********************************************************************************

;'PROGRAM_MEMORY_PAGE: 1
	PSECT	PROGMEM1,CLASS=CODE,SPACE=SPACE_CODE,DELTA=2, ABS, OVRLD 
	ORG	2048
;'
;' Declare Power-On-Reset entry point
;'
 END     RESETVEC
