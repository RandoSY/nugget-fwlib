;'Program compiled by GCBASIC (2025.10.04 (Windows 64 bit) : Build 1523) for Microchip PIC-AS using FreeBASIC 1.07.1/2025-10-03 CRC248
;'  Please donate to help support the operational costs of the project.  Donate via https://gcbasic.com/donate/
;'  
;'  See the GCBASIC forums at http://sourceforge.net/projects/gcbasic/forums,
;'  Check the documentation and Help at http://gcbasic.sourceforge.net/help/,
;'or, email:
;'   evanvennn at users dot sourceforge dot net
;'********************************************************************************
;'   Installation Dir : C:\GCstudio\gcbasic
;'   Source file      : C:\Users\rasyoung\Desktop\nugget-fwlib\examples\020_full_tiny_gsa_node\020_full_tiny_gsa_node.gcb
;'   Setting file     : C:\GCstudio\gcbasic\use.ini
;'   Preserve mode    : 0
;'   Assembler        : "C:\Program Files\Microchip\xc8\v2.36\pic-as\bin\pic-as.exe"
;'   Programmer       : 
;'   Output file      : C:\Users\rasyoung\Desktop\nugget-fwlib\examples\020_full_tiny_gsa_node\020_full_tiny_gsa_node.asm
;'   Float Capability : 0
;'********************************************************************************

;'Set up the assembler options (Chip type, clock source, other bits and pieces)
;'PROCESSOR   16F18424
 PAGEWIDTH   180
 RADIX       DEC
 TITLE       "C:\Users\rasyoung\Desktop\nugget-fwlib\examples\020_full_tiny_gsa_node\020_full_tiny_gsa_node.gcb"
 SUBTITLE    "05-24-2026 16:22:02"

;' Reverse lookup file(s)
;' C:\Users\rasyoung\.mchp_packs\Microchip\PIC16F1xxxx_DFP\1.31.465\xc8\pic\include\proc\pic16f18424.inc
;' C:\Program Files\Microchip\xc8\v2.36\pic\dat\cfgdata\16f18424.cfgdata

;'********************************************************************************

;'********************************************************************************
;'Explicit CONFIG
 CONFIG FCMEN=ON                                 ;C1 Reverselookup FCMEN = ON
 CONFIG CLKOUTEN=OFF                             ;C1 Reverselookup CLKOUTEN = OFF
 CONFIG RSTOSC=HFINT32                           ;C1 Reverselookup RSTOSC = HFINT32
 CONFIG FEXTOSC=OFF                              ;C1 Reverselookup FEXTOSC = OFF
 CONFIG MCLRE=ON                                 ;C1 Reverselookup MCLRE = ON
 CONFIG WDTE=OFF                                 ;C1 Reverselookup WDTE = OFF
 CONFIG LVP=ON                                   ;C1 Reverselookup LVP = ON
 CONFIG WRTSAF=OFF                               ;C1 Reverselookup WRTSAF = OFF
 CONFIG WRTD=OFF                                 ;C1 Reverselookup WRTD = OFF
 CONFIG WRTB=OFF                                 ;C1 Reverselookup WRTB = OFF
 CONFIG CP=OFF                                   ;C1 Reverselookup CP = OFF
;'Inferred CONFIG


;'********************************************************************************
;' The XC8 xc.inc include file.  This MUST be placed after the CONFIG statements.

 #include <xc.inc>

;'********************************************************************************

;'Set aside RAM memory locations for variables. All variables are global.
 ADREADPORT                       EQU 32          ; 0X20
 ANSELB                           EQU 33          ; 0X21
 COMPORT                          EQU 34          ; 0X22
 DELAYTEMP                        EQU 112          ; 0X70 (SA)
 DELAYTEMP2                       EQU 113          ; 0X71 (SA)
 HSERPRINTCRLFCOUNT               EQU 35          ; 0X23
 OUTVALUETEMP                     EQU 36          ; 0X24
 PRINTLEN                         EQU 37          ; 0X25
 RB_ADC_READAVERAGE_AN2           EQU 38          ; 0X26
 RB_ADC_READAVERAGE_AN2_H         EQU 39          ; 0X27
 RB_I                             EQU 40          ; 0X28
 RB_SAMPLES                       EQU 41          ; 0X29
 RB_TOTAL                         EQU 42          ; 0X2A
 RB_TOTAL_E                       EQU 45          ; 0X2D
 RB_TOTAL_H                       EQU 43          ; 0X2B
 RB_TOTAL_U                       EQU 44          ; 0X2C
 READAD                           EQU 46          ; 0X2E
 SAMPLE                           EQU 47          ; 0X2F
 SAMPLE_E                         EQU 50          ; 0X32
 SAMPLE_H                         EQU 48          ; 0X30
 SAMPLE_U                         EQU 49          ; 0X31
 SERDATA                          EQU 51          ; 0X33
 SERPRINTVAL                      EQU 52          ; 0X34
 SERPRINTVAL_E                    EQU 55          ; 0X37
 SERPRINTVAL_H                    EQU 53          ; 0X35
 SERPRINTVAL_U                    EQU 54          ; 0X36
 STRINGPOINTER                    EQU 56          ; 0X38
 SYSBITVAR0                       EQU 57          ; 0X39
 SYSBYTETEMPX                     EQU 112          ; 0X70 (SA)
 SYSCALCTEMPA                     EQU 117          ; 0X75 (SA)
 SYSCALCTEMPA_E                   EQU 120          ; 0X78 (SA)
 SYSCALCTEMPA_H                   EQU 118          ; 0X76 (SA)
 SYSCALCTEMPA_U                   EQU 119          ; 0X77 (SA)
 SYSCALCTEMPX                     EQU 112          ; 0X70 (SA)
 SYSCALCTEMPX_H                   EQU 113          ; 0X71 (SA)
 SYSDIVLOOP                       EQU 116          ; 0X74 (SA)
 SYSDIVMULTA                      EQU 119          ; 0X77 (SA)
 SYSDIVMULTA_H                    EQU 120          ; 0X78 (SA)
 SYSDIVMULTB                      EQU 123          ; 0X7B (SA)
 SYSDIVMULTB_H                    EQU 124          ; 0X7C (SA)
 SYSDIVMULTX                      EQU 114          ; 0X72 (SA)
 SYSDIVMULTX_H                    EQU 115          ; 0X73 (SA)
 SYSLONGDIVMULTA                  EQU 58          ; 0X3A
 SYSLONGDIVMULTA_E                EQU 61          ; 0X3D
 SYSLONGDIVMULTA_H                EQU 59          ; 0X3B
 SYSLONGDIVMULTA_U                EQU 60          ; 0X3C
 SYSLONGDIVMULTB                  EQU 62          ; 0X3E
 SYSLONGDIVMULTB_E                EQU 65          ; 0X41
 SYSLONGDIVMULTB_H                EQU 63          ; 0X3F
 SYSLONGDIVMULTB_U                EQU 64          ; 0X40
 SYSLONGDIVMULTX                  EQU 66          ; 0X42
 SYSLONGDIVMULTX_E                EQU 69          ; 0X45
 SYSLONGDIVMULTX_H                EQU 67          ; 0X43
 SYSLONGDIVMULTX_U                EQU 68          ; 0X44
 SYSLONGTEMPA                     EQU 117          ; 0X75 (SA)
 SYSLONGTEMPA_E                   EQU 120          ; 0X78 (SA)
 SYSLONGTEMPA_H                   EQU 118          ; 0X76 (SA)
 SYSLONGTEMPA_U                   EQU 119          ; 0X77 (SA)
 SYSLONGTEMPB                     EQU 121          ; 0X79 (SA)
 SYSLONGTEMPB_E                   EQU 124          ; 0X7C (SA)
 SYSLONGTEMPB_H                   EQU 122          ; 0X7A (SA)
 SYSLONGTEMPB_U                   EQU 123          ; 0X7B (SA)
 SYSLONGTEMPX                     EQU 112          ; 0X70 (SA)
 SYSLONGTEMPX_E                   EQU 115          ; 0X73 (SA)
 SYSLONGTEMPX_H                   EQU 113          ; 0X71 (SA)
 SYSLONGTEMPX_U                   EQU 114          ; 0X72 (SA)
 SYSPRINTBUFFER                   EQU 8677          ; 0X21E5
 SYSPRINTBUFFLEN                  EQU 70          ; 0X46
 SYSPRINTDATAHANDLER              EQU 71          ; 0X47
 SYSPRINTDATAHANDLER_H            EQU 72          ; 0X48
 SYSPRINTTEMP                     EQU 73          ; 0X49
 SYSREPEATTEMP1                   EQU 74          ; 0X4A
 SYSSTRINGA                       EQU 119          ; 0X77 (SA)
 SYSSTRINGA_H                     EQU 120          ; 0X78 (SA)
 SYSTEMP1                         EQU 75          ; 0X4B
 SYSTEMP1_E                       EQU 78          ; 0X4E
 SYSTEMP1_H                       EQU 76          ; 0X4C
 SYSTEMP1_U                       EQU 77          ; 0X4D
 SYSWAITTEMP10US                  EQU 117          ; 0X75 (SA)
 SYSWAITTEMPMS                    EQU 114          ; 0X72 (SA)
 SYSWAITTEMPMS_H                  EQU 115          ; 0X73 (SA)
 SYSWORDTEMPA                     EQU 117          ; 0X75 (SA)
 SYSWORDTEMPA_H                   EQU 118          ; 0X76 (SA)
 SYSWORDTEMPB                     EQU 121          ; 0X79 (SA)
 SYSWORDTEMPB_H                   EQU 122          ; 0X7A (SA)
 SYSWORDTEMPX                     EQU 112          ; 0X70 (SA)
 SYSWORDTEMPX_H                   EQU 113          ; 0X71 (SA)
 VALUE                            EQU 79          ; 0X4F
 VALUE_H                          EQU 80          ; 0X50

;'********************************************************************************

;'ALIAS VARIABLES
 AFSR0                            EQU 4
 AFSR0_H                          EQU 5
 SYSREADADBYTE                    EQU 46

;'********************************************************************************

 PSECT   PROGMEM0,delta=2, abs
 RESETVEC:
;'VECTORS
	ORG	0
	PAGESEL	BASPROGRAMSTART
	GOTO	BASPROGRAMSTART
	ORG	4
	RETFIE

;'********************************************************************************

;'PROGRAM_MEMORY_PAGE: 0
	ORG	5
BASPROGRAMSTART:
;'CALL INITIALISATION ROUTINES
	CALL	INITSYS
	CALL	INITUSART

;'START_OF_THE_MAIN_PROGRAM
	CALL	RB_CORE_INIT
	CALL	RB_SW1_INITPULLUP
	CALL	RB_LED_STATUS_INIT
	CALL	RB_ADC_INIT
	BCF	SYSBITVAR0,0
	CLRF	SAMPLE
	CLRF	SAMPLE_H
	CLRF	SAMPLE_U
	CLRF	SAMPLE_E
	MOVLW	LOW STRINGTABLE5
	MOVWF	SYSPRINTDATAHANDLER
	MOVLW	(HIGH STRINGTABLE5) | 128
	MOVWF	SYSPRINTDATAHANDLER_H
	MOVLW	1
	MOVWF	COMPORT
	CALL	HSERPRINT377
	MOVLW	1
	MOVWF	HSERPRINTCRLFCOUNT
	MOVLW	1
	MOVWF	COMPORT
	CALL	HSERPRINTCRLF
	MOVLW	LOW STRINGTABLE6
	MOVWF	SYSPRINTDATAHANDLER
	MOVLW	(HIGH STRINGTABLE6) | 128
	MOVWF	SYSPRINTDATAHANDLER_H
	MOVLW	1
	MOVWF	COMPORT
	CALL	HSERPRINT377
	MOVLW	1
	MOVWF	HSERPRINTCRLFCOUNT
	MOVLW	1
	MOVWF	COMPORT
	CALL	HSERPRINTCRLF
SYSDOLOOP_S1:
	CALL	FN_RB_SW1_PRESSEDEVENT
	BTFSS	SYSBITVAR0,6
	GOTO	ENDIF1
	BTFSS	SYSBITVAR0,0
	GOTO	ELSE3_1
	BCF	SYSBITVAR0,0
	MOVLW	LOW STRINGTABLE7
	MOVWF	SYSPRINTDATAHANDLER
	MOVLW	(HIGH STRINGTABLE7) | 128
	MOVWF	SYSPRINTDATAHANDLER_H
	MOVLW	1
	MOVWF	COMPORT
	CALL	HSERPRINT377
	MOVLW	1
	MOVWF	HSERPRINTCRLFCOUNT
	MOVLW	1
	MOVWF	COMPORT
	CALL	HSERPRINTCRLF
	GOTO	ENDIF3
ELSE3_1:
	BSF	SYSBITVAR0,0
	MOVLW	LOW STRINGTABLE8
	MOVWF	SYSPRINTDATAHANDLER
	MOVLW	(HIGH STRINGTABLE8) | 128
	MOVWF	SYSPRINTDATAHANDLER_H
	MOVLW	1
	MOVWF	COMPORT
	CALL	HSERPRINT377
	MOVLW	1
	MOVWF	HSERPRINTCRLFCOUNT
	MOVLW	1
	MOVWF	COMPORT
	CALL	HSERPRINTCRLF
ENDIF3:
	CALL	RB_SW1_WAITFORRELEASE
ENDIF1:
	BTFSS	SYSBITVAR0,0
	GOTO	ELSE2_1
	MOVLW	8
	MOVWF	RB_SAMPLES
	CALL	FN_RB_ADC_READAVERAGE_AN2
	MOVF	RB_ADC_READAVERAGE_AN2,W
	MOVWF	VALUE
	MOVF	RB_ADC_READAVERAGE_AN2_H,W
	MOVWF	VALUE_H
	MOVLW	LOW STRINGTABLE9
	MOVWF	SYSPRINTDATAHANDLER
	MOVLW	(HIGH STRINGTABLE9) | 128
	MOVWF	SYSPRINTDATAHANDLER_H
	MOVLW	1
	MOVWF	COMPORT
	CALL	HSERPRINT377
	MOVF	SAMPLE,W
	MOVWF	SERPRINTVAL
	MOVF	SAMPLE_H,W
	MOVWF	SERPRINTVAL_H
	MOVF	SAMPLE_U,W
	MOVWF	SERPRINTVAL_U
	MOVF	SAMPLE_E,W
	MOVWF	SERPRINTVAL_E
	MOVLW	1
	MOVWF	COMPORT
	CALL	HSERPRINT382
	MOVLW	LOW STRINGTABLE10
	MOVWF	SYSPRINTDATAHANDLER
	MOVLW	(HIGH STRINGTABLE10) | 128
	MOVWF	SYSPRINTDATAHANDLER_H
	MOVLW	1
	MOVWF	COMPORT
	CALL	HSERPRINT377
	MOVF	VALUE,W
	MOVWF	SERPRINTVAL
	MOVF	VALUE_H,W
	MOVWF	SERPRINTVAL_H
	MOVLW	1
	MOVWF	COMPORT
	CALL	HSERPRINT380
	MOVLW	1
	MOVWF	HSERPRINTCRLFCOUNT
	MOVLW	1
	MOVWF	COMPORT
	CALL	HSERPRINTCRLF
	INCF	SAMPLE,F
	BTFSC	STATUS,2
	INCF	SAMPLE_H,F
	BTFSC	STATUS,2
	INCF	SAMPLE_U,F
	BTFSC	STATUS,2
	INCF	SAMPLE_E,F
	CALL	RB_LED_STATUS_TOGGLE
	MOVLW	244
	MOVWF	SYSWAITTEMPMS
	MOVLW	1
	MOVWF	SYSWAITTEMPMS_H
	CALL	DELAY_MS
	GOTO	ENDIF2
ELSE2_1:
	CALL	RB_LED_STATUS_OFF
	MOVLW	50
	MOVWF	SYSWAITTEMPMS
	CLRF	SYSWAITTEMPMS_H
	CALL	DELAY_MS
ENDIF2:
	GOTO	SYSDOLOOP_S1
SYSDOLOOP_E1:
BASPROGRAMEND:
	SLEEP
	GOTO	BASPROGRAMEND

;'********************************************************************************

DELAY_10US:
D10US_START:
	MOVLW	25
	MOVWF	DELAYTEMP
DELAYUS0:
	DECFSZ	DELAYTEMP,F
	GOTO	DELAYUS0
	NOP
	DECFSZ	SYSWAITTEMP10US, F
	GOTO	D10US_START
	RETURN

;'********************************************************************************

DELAY_MS:
	INCF	SYSWAITTEMPMS_H, F
DMS_START:
	MOVLW	14
	MOVWF	DELAYTEMP2
DMS_OUTER:
	MOVLW	189
	MOVWF	DELAYTEMP
DMS_INNER:
	DECFSZ	DELAYTEMP, F
	GOTO	DMS_INNER
	DECFSZ	DELAYTEMP2, F
	GOTO	DMS_OUTER
	DECFSZ	SYSWAITTEMPMS, F
	GOTO	DMS_START
	DECFSZ	SYSWAITTEMPMS_H, F
	GOTO	DMS_START
	RETURN

;'********************************************************************************

HSERPRINT377:
	MOVF	SYSPRINTDATAHANDLER,W
	MOVWF	FSR0L
	MOVF	SYSPRINTDATAHANDLER_H,W
	MOVWF	FSR0H
	MOVF	INDF0,W
	MOVWF	PRINTLEN
	MOVF	PRINTLEN,F
	BTFSC	STATUS,2
	GOTO	ENDIF16
	CLRF	SYSPRINTTEMP
	MOVLW	1
	SUBWF	PRINTLEN,W
	BTFSS	STATUS,0
	GOTO	SYSFORLOOPEND2
SYSFORLOOP2:
	INCF	SYSPRINTTEMP,F
	MOVF	SYSPRINTTEMP,W
	ADDWF	SYSPRINTDATAHANDLER,W
	MOVWF	FSR0L
	MOVLW	0
	ADDWFC	SYSPRINTDATAHANDLER_H,W
	MOVWF	FSR0H
	MOVF	INDF0,W
	MOVWF	SERDATA
	CALL	HSERSEND365
	MOVF	PRINTLEN,W
	SUBWF	SYSPRINTTEMP,W
	BTFSS	STATUS,0
	GOTO	SYSFORLOOP2
SYSFORLOOPEND2:
ENDIF16:
	RETURN

;'********************************************************************************

HSERPRINT380:
	CLRF	OUTVALUETEMP
	MOVF	SERPRINTVAL,W
	MOVWF	SYSWORDTEMPA
	MOVF	SERPRINTVAL_H,W
	MOVWF	SYSWORDTEMPA_H
	MOVLW	16
	MOVWF	SYSWORDTEMPB
	MOVLW	39
	MOVWF	SYSWORDTEMPB_H
	CALL	SYSCOMPLESSTHAN16
	COMF	SYSBYTETEMPX,F
	BTFSS	SYSBYTETEMPX,0
	GOTO	ENDIF19
	MOVF	SERPRINTVAL,W
	MOVWF	SYSWORDTEMPA
	MOVF	SERPRINTVAL_H,W
	MOVWF	SYSWORDTEMPA_H
	MOVLW	16
	MOVWF	SYSWORDTEMPB
	MOVLW	39
	MOVWF	SYSWORDTEMPB_H
	CALL	SYSDIVSUB16
	MOVF	SYSWORDTEMPA,W
	MOVWF	OUTVALUETEMP
	MOVF	SYSCALCTEMPX,W
	MOVWF	SERPRINTVAL
	MOVF	SYSCALCTEMPX_H,W
	MOVWF	SERPRINTVAL_H
	MOVLW	48
	ADDWF	OUTVALUETEMP,W
	MOVWF	SERDATA
	CALL	HSERSEND365
	GOTO	HSERPRINTWORD1000
ENDIF19:
	MOVF	SERPRINTVAL,W
	MOVWF	SYSWORDTEMPA
	MOVF	SERPRINTVAL_H,W
	MOVWF	SYSWORDTEMPA_H
	MOVLW	232
	MOVWF	SYSWORDTEMPB
	MOVLW	3
	MOVWF	SYSWORDTEMPB_H
	CALL	SYSCOMPLESSTHAN16
	COMF	SYSBYTETEMPX,F
	BTFSS	SYSBYTETEMPX,0
	GOTO	ENDIF20
HSERPRINTWORD1000:
	MOVF	SERPRINTVAL,W
	MOVWF	SYSWORDTEMPA
	MOVF	SERPRINTVAL_H,W
	MOVWF	SYSWORDTEMPA_H
	MOVLW	232
	MOVWF	SYSWORDTEMPB
	MOVLW	3
	MOVWF	SYSWORDTEMPB_H
	CALL	SYSDIVSUB16
	MOVF	SYSWORDTEMPA,W
	MOVWF	OUTVALUETEMP
	MOVF	SYSCALCTEMPX,W
	MOVWF	SERPRINTVAL
	MOVF	SYSCALCTEMPX_H,W
	MOVWF	SERPRINTVAL_H
	MOVLW	48
	ADDWF	OUTVALUETEMP,W
	MOVWF	SERDATA
	CALL	HSERSEND365
	GOTO	HSERPRINTWORD100
ENDIF20:
	MOVF	SERPRINTVAL,W
	MOVWF	SYSWORDTEMPA
	MOVF	SERPRINTVAL_H,W
	MOVWF	SYSWORDTEMPA_H
	MOVLW	100
	MOVWF	SYSWORDTEMPB
	CLRF	SYSWORDTEMPB_H
	CALL	SYSCOMPLESSTHAN16
	COMF	SYSBYTETEMPX,F
	BTFSS	SYSBYTETEMPX,0
	GOTO	ENDIF21
HSERPRINTWORD100:
	MOVF	SERPRINTVAL,W
	MOVWF	SYSWORDTEMPA
	MOVF	SERPRINTVAL_H,W
	MOVWF	SYSWORDTEMPA_H
	MOVLW	100
	MOVWF	SYSWORDTEMPB
	CLRF	SYSWORDTEMPB_H
	CALL	SYSDIVSUB16
	MOVF	SYSWORDTEMPA,W
	MOVWF	OUTVALUETEMP
	MOVF	SYSCALCTEMPX,W
	MOVWF	SERPRINTVAL
	MOVF	SYSCALCTEMPX_H,W
	MOVWF	SERPRINTVAL_H
	MOVLW	48
	ADDWF	OUTVALUETEMP,W
	MOVWF	SERDATA
	CALL	HSERSEND365
	GOTO	HSERPRINTWORD10
ENDIF21:
	MOVF	SERPRINTVAL,W
	MOVWF	SYSWORDTEMPA
	MOVF	SERPRINTVAL_H,W
	MOVWF	SYSWORDTEMPA_H
	MOVLW	10
	MOVWF	SYSWORDTEMPB
	CLRF	SYSWORDTEMPB_H
	CALL	SYSCOMPLESSTHAN16
	COMF	SYSBYTETEMPX,F
	BTFSS	SYSBYTETEMPX,0
	GOTO	ENDIF22
HSERPRINTWORD10:
	MOVF	SERPRINTVAL,W
	MOVWF	SYSWORDTEMPA
	MOVF	SERPRINTVAL_H,W
	MOVWF	SYSWORDTEMPA_H
	MOVLW	10
	MOVWF	SYSWORDTEMPB
	CLRF	SYSWORDTEMPB_H
	CALL	SYSDIVSUB16
	MOVF	SYSWORDTEMPA,W
	MOVWF	OUTVALUETEMP
	MOVF	SYSCALCTEMPX,W
	MOVWF	SERPRINTVAL
	MOVF	SYSCALCTEMPX_H,W
	MOVWF	SERPRINTVAL_H
	MOVLW	48
	ADDWF	OUTVALUETEMP,W
	MOVWF	SERDATA
	CALL	HSERSEND365
ENDIF22:
	MOVF	SERPRINTVAL,W
	MOVWF	OUTVALUETEMP
	MOVLW	48
	ADDWF	OUTVALUETEMP,W
	MOVWF	SERDATA
	GOTO	HSERSEND365

;'********************************************************************************

HSERPRINT382:
	CLRF	SYSPRINTBUFFLEN
SYSDOLOOP_S3:
	INCF	SYSPRINTBUFFLEN,F
	MOVLW	LOW(SYSPRINTBUFFER)
	ADDWF	SYSPRINTBUFFLEN,W
	MOVWF	FSR0L
	CLRF	SYSTEMP1
	MOVLW	HIGH(SYSPRINTBUFFER)
	ADDWFC	SYSTEMP1,W
	MOVWF	FSR0H
	MOVF	SERPRINTVAL,W
	MOVWF	SYSLONGTEMPA
	MOVF	SERPRINTVAL_H,W
	MOVWF	SYSLONGTEMPA_H
	MOVF	SERPRINTVAL_U,W
	MOVWF	SYSLONGTEMPA_U
	MOVF	SERPRINTVAL_E,W
	MOVWF	SYSLONGTEMPA_E
	MOVLW	10
	MOVWF	SYSLONGTEMPB
	CLRF	SYSLONGTEMPB_H
	CLRF	SYSLONGTEMPB_U
	CLRF	SYSLONGTEMPB_E
	CALL	SYSDIVSUB32
	MOVF	SYSLONGTEMPX,W
	MOVWF	INDF0
	MOVF	SYSCALCTEMPA,W
	MOVWF	SERPRINTVAL
	MOVF	SYSCALCTEMPA_H,W
	MOVWF	SERPRINTVAL_H
	MOVF	SYSCALCTEMPA_U,W
	MOVWF	SERPRINTVAL_U
	MOVF	SYSCALCTEMPA_E,W
	MOVWF	SERPRINTVAL_E
	MOVF	SERPRINTVAL,W
	MOVWF	SYSLONGTEMPA
	MOVF	SERPRINTVAL_H,W
	MOVWF	SYSLONGTEMPA_H
	MOVF	SERPRINTVAL_U,W
	MOVWF	SYSLONGTEMPA_U
	MOVF	SERPRINTVAL_E,W
	MOVWF	SYSLONGTEMPA_E
	CLRF	SYSLONGTEMPB
	CLRF	SYSLONGTEMPB_H
	CLRF	SYSLONGTEMPB_U
	CLRF	SYSLONGTEMPB_E
	CALL	SYSCOMPEQUAL32
	COMF	SYSBYTETEMPX,F
	BTFSC	SYSBYTETEMPX,0
	GOTO	SYSDOLOOP_S3
SYSDOLOOP_E3:
	INCF	SYSPRINTBUFFLEN,W
	MOVWF	SYSPRINTTEMP
	MOVLW	1
	SUBWF	SYSPRINTBUFFLEN,W
	BTFSS	STATUS,0
	GOTO	SYSFORLOOPEND3
SYSFORLOOP3:
	DECF	SYSPRINTTEMP,F
	MOVLW	LOW(SYSPRINTBUFFER)
	ADDWF	SYSPRINTTEMP,W
	MOVWF	FSR0L
	CLRF	SYSTEMP1
	MOVLW	HIGH(SYSPRINTBUFFER)
	ADDWFC	SYSTEMP1,W
	MOVWF	FSR0H
	MOVLW	48
	ADDWF	INDF0,W
	MOVWF	SERDATA
	CALL	HSERSEND365
	MOVF	SYSPRINTTEMP,W
	SUBLW	1
	BTFSS	STATUS,0
	GOTO	SYSFORLOOP3
SYSFORLOOPEND3:
	RETURN

;'********************************************************************************

HSERPRINTCRLF:
	MOVF	HSERPRINTCRLFCOUNT,W
	MOVWF	SYSREPEATTEMP1
	BTFSC	STATUS,2
	GOTO	SYSREPEATLOOPEND1
SYSREPEATLOOP1:
	MOVLW	13
	MOVWF	SERDATA
	CALL	HSERSEND365
	MOVLW	10
	MOVWF	SERDATA
	CALL	HSERSEND365
	DECFSZ	SYSREPEATTEMP1,F
	GOTO	SYSREPEATLOOP1
SYSREPEATLOOPEND1:
	RETURN

;'********************************************************************************

HSERSEND365:
HSERSENDUSART1HANDLER:
	MOVF	SERDATA,W
	BANKSEL	TX1REG
	MOVWF	TX1REG
	MOVLW	1
	MOVWF	SYSWAITTEMPMS
	CLRF	SYSWAITTEMPMS_H
	BANKSEL	STATUS
	GOTO	DELAY_MS

;'********************************************************************************

INITSYS:
;'DEFAULT SETTINGS FOR MICROCONTROLLERS WITH _OSCCON1_
	MOVLW	96
	BANKSEL	OSCCON1
	MOVWF	OSCCON1
	CLRF	OSCCON3
	CLRF	OSCEN
	CLRF	OSCTUNE
;'THE MCU IS A CHIP FAMILY CHIPFAMILY
;'OSCCON TYPE IS 102
	MOVLW	6
	MOVWF	OSCFRQ
;'_COMPLETE_THE_CHIP_SETUP_OF_BSR_ADCS_ANSEL_AND_OTHER_KEY_SETUP_REGISTERS_OR_REGISTER_BITS
	BANKSEL	ADCON0
	BCF	ADCON0,2
	BCF	ADCON0,7
	BANKSEL	ANSELA
	CLRF	ANSELA
	CLRF	ANSELC
	BANKSEL	CM2CON0
	BCF	CM2CON0,7
	BCF	CM1CON0,7
	BANKSEL	PORTA
	CLRF	PORTA
	CLRF	PORTC
	RETURN

;'********************************************************************************

INITUSART:
	MOVLW	3
	BANKSEL	SP1BRGH
	MOVWF	SP1BRGH
	MOVLW	64
	MOVWF	SP1BRGL
	MOVLW	64
	MOVWF	SP1BRGL
	BSF	BAUD1CON,3
	BSF	TX1STA,2
	BCF	TX1STA,4
	BSF	TX1STA,5
	BSF	RC1STA,7
	BSF	RC1STA,4
	BSF	RC1STA,4
	BANKSEL	STATUS
	RETURN

;'********************************************************************************

RB_ADC_INIT:
	BSF	TRISA,2
	BANKSEL	ANSELA
	BSF	ANSELA,2
	BANKSEL	STATUS
	RETURN

;'********************************************************************************

FN_RB_ADC_READAVERAGE_AN2:
	CLRF	RB_TOTAL
	CLRF	RB_TOTAL_H
	CLRF	RB_TOTAL_U
	CLRF	RB_TOTAL_E
	CLRF	RB_I
	MOVLW	1
	SUBWF	RB_SAMPLES,W
	BTFSS	STATUS,0
	GOTO	SYSFORLOOPEND1
SYSFORLOOP1:
	INCF	RB_I,F
	MOVLW	2
	MOVWF	ADREADPORT
	CALL	FN_READAD26
	MOVF	SYSREADADBYTE,W
	ADDWF	RB_TOTAL,F
	MOVLW	0
	ADDWFC	RB_TOTAL_H,F
	MOVLW	0
	ADDWFC	RB_TOTAL_U,F
	MOVLW	0
	ADDWFC	RB_TOTAL_E,F
	MOVLW	2
	MOVWF	SYSWAITTEMPMS
	CLRF	SYSWAITTEMPMS_H
	CALL	DELAY_MS
	MOVF	RB_SAMPLES,W
	SUBWF	RB_I,W
	BTFSS	STATUS,0
	GOTO	SYSFORLOOP1
SYSFORLOOPEND1:
	MOVF	RB_TOTAL,W
	MOVWF	SYSLONGTEMPA
	MOVF	RB_TOTAL_H,W
	MOVWF	SYSLONGTEMPA_H
	MOVF	RB_TOTAL_U,W
	MOVWF	SYSLONGTEMPA_U
	MOVF	RB_TOTAL_E,W
	MOVWF	SYSLONGTEMPA_E
	MOVF	RB_SAMPLES,W
	MOVWF	SYSLONGTEMPB
	CLRF	SYSLONGTEMPB_H
	CLRF	SYSLONGTEMPB_U
	CLRF	SYSLONGTEMPB_E
	CALL	SYSDIVSUB32
	MOVF	SYSLONGTEMPA,W
	MOVWF	RB_ADC_READAVERAGE_AN2
	MOVF	SYSLONGTEMPA_H,W
	MOVWF	RB_ADC_READAVERAGE_AN2_H
	RETURN

;'********************************************************************************

RB_CORE_ALLDIGITAL:
	BANKSEL	ANSELA
	CLRF	ANSELA
	CLRF	ANSELC
	BANKSEL	STATUS
	RETURN

;'********************************************************************************

RB_CORE_CLEARLATCHES:
	CLRF	LATA
	CLRF	LATC
	RETURN

;'********************************************************************************

RB_CORE_INIT:
	CALL	RB_CORE_ALLDIGITAL
	GOTO	RB_CORE_CLEARLATCHES

;'********************************************************************************

RB_LED_STATUS_INIT:
	BCF	TRISC,0
	BANKSEL	ANSELC
	BCF	ANSELC,0
	BANKSEL	LATC
	BCF	LATC,0
	RETURN

;'********************************************************************************

RB_LED_STATUS_OFF:
	BCF	LATC,0
	RETURN

;'********************************************************************************

RB_LED_STATUS_TOGGLE:
	CLRF	SYSTEMP1
	BTFSC	LATC,0
	INCF	SYSTEMP1,F
	COMF	SYSTEMP1,F
	BCF	LATC,0
	BTFSC	SYSTEMP1,0
	BSF	LATC,0
	RETURN

;'********************************************************************************

RB_SW1_INITPULLUP:
	BSF	TRISA,0
	BANKSEL	ANSELA
	BCF	ANSELA,0
	BSF	WPUA,0
	BANKSEL	SYSBITVAR0
	BCF	SYSBITVAR0,1
	BTFSC	PORTA,0
	BSF	SYSBITVAR0,1
	BCF	SYSBITVAR0,2
	RETURN

;'********************************************************************************

FN_RB_SW1_PRESSEDEVENT:
	BCF	SYSBITVAR0,6
	BTFSS	SYSBITVAR0,1
	GOTO	ENDIF5
	BTFSC	PORTA,0
	GOTO	ENDIF6
	MOVLW	20
	MOVWF	SYSWAITTEMPMS
	CLRF	SYSWAITTEMPMS_H
	CALL	DELAY_MS
	BTFSS	PORTA,0
	BSF	SYSBITVAR0,6
ENDIF6:
ENDIF5:
	BCF	SYSBITVAR0,1
	BTFSC	PORTA,0
	BSF	SYSBITVAR0,1
	RETURN

;'********************************************************************************

RB_SW1_WAITFORRELEASE:
SYSDOLOOP_S2:
	BTFSC	PORTA,0
	GOTO	SYSDOLOOP_E2
	GOTO	SYSDOLOOP_S2
SYSDOLOOP_E2:
	MOVLW	20
	MOVWF	SYSWAITTEMPMS
	CLRF	SYSWAITTEMPMS_H
	GOTO	DELAY_MS

;'********************************************************************************

FN_READAD26:
	BANKSEL	ADCON0
	BCF	ADCON0,2
	BANKSEL	ADREADPORT
	MOVF	ADREADPORT,W
	BANKSEL	ADPCH
	MOVWF	ADPCH
SYSSELECT1CASE1:
	BANKSEL	ADREADPORT
	MOVF	ADREADPORT,F
	BTFSS	STATUS,2
	GOTO	SYSSELECT1CASE2
	BANKSEL	ANSELA
	BSF	ANSELA,0
	GOTO	SYSSELECTEND1
SYSSELECT1CASE2:
	DECF	ADREADPORT,W
	BTFSS	STATUS,2
	GOTO	SYSSELECT1CASE3
	BANKSEL	ANSELA
	BSF	ANSELA,1
	GOTO	SYSSELECTEND1
SYSSELECT1CASE3:
	MOVLW	2
	SUBWF	ADREADPORT,W
	BTFSS	STATUS,2
	GOTO	SYSSELECT1CASE4
	BANKSEL	ANSELA
	BSF	ANSELA,2
	GOTO	SYSSELECTEND1
SYSSELECT1CASE4:
	MOVLW	3
	SUBWF	ADREADPORT,W
	BTFSS	STATUS,2
	GOTO	SYSSELECT1CASE5
	BANKSEL	ANSELA
	BSF	ANSELA,3
	GOTO	SYSSELECTEND1
SYSSELECT1CASE5:
	MOVLW	4
	SUBWF	ADREADPORT,W
	BTFSS	STATUS,2
	GOTO	SYSSELECT1CASE6
	BANKSEL	ANSELA
	BSF	ANSELA,4
	GOTO	SYSSELECTEND1
SYSSELECT1CASE6:
	MOVLW	5
	SUBWF	ADREADPORT,W
	BTFSS	STATUS,2
	GOTO	SYSSELECT1CASE7
	BANKSEL	ANSELA
	BSF	ANSELA,5
	GOTO	SYSSELECTEND1
SYSSELECT1CASE7:
	MOVLW	6
	SUBWF	ADREADPORT,W
	BTFSS	STATUS,2
	GOTO	SYSSELECT1CASE8
	BANKSEL	ANSELA
	BSF	ANSELA,6
	GOTO	SYSSELECTEND1
SYSSELECT1CASE8:
	MOVLW	7
	SUBWF	ADREADPORT,W
	BTFSS	STATUS,2
	GOTO	SYSSELECT1CASE9
	BANKSEL	ANSELA
	BSF	ANSELA,7
	GOTO	SYSSELECTEND1
SYSSELECT1CASE9:
	MOVLW	8
	SUBWF	ADREADPORT,W
	BTFSS	STATUS,2
	GOTO	SYSSELECT1CASE10
	BSF	ANSELB,0
	GOTO	SYSSELECTEND1
SYSSELECT1CASE10:
	MOVLW	9
	SUBWF	ADREADPORT,W
	BTFSS	STATUS,2
	GOTO	SYSSELECT1CASE11
	BSF	ANSELB,1
	GOTO	SYSSELECTEND1
SYSSELECT1CASE11:
	MOVLW	10
	SUBWF	ADREADPORT,W
	BTFSS	STATUS,2
	GOTO	SYSSELECT1CASE12
	BSF	ANSELB,2
	GOTO	SYSSELECTEND1
SYSSELECT1CASE12:
	MOVLW	11
	SUBWF	ADREADPORT,W
	BTFSS	STATUS,2
	GOTO	SYSSELECT1CASE13
	BSF	ANSELB,3
	GOTO	SYSSELECTEND1
SYSSELECT1CASE13:
	MOVLW	12
	SUBWF	ADREADPORT,W
	BTFSS	STATUS,2
	GOTO	SYSSELECT1CASE14
	BSF	ANSELB,4
	GOTO	SYSSELECTEND1
SYSSELECT1CASE14:
	MOVLW	13
	SUBWF	ADREADPORT,W
	BTFSS	STATUS,2
	GOTO	SYSSELECT1CASE15
	BSF	ANSELB,5
	GOTO	SYSSELECTEND1
SYSSELECT1CASE15:
	MOVLW	14
	SUBWF	ADREADPORT,W
	BTFSS	STATUS,2
	GOTO	SYSSELECT1CASE16
	BSF	ANSELB,6
	GOTO	SYSSELECTEND1
SYSSELECT1CASE16:
	MOVLW	15
	SUBWF	ADREADPORT,W
	BTFSS	STATUS,2
	GOTO	SYSSELECT1CASE17
	BSF	ANSELB,7
	GOTO	SYSSELECTEND1
SYSSELECT1CASE17:
	MOVLW	16
	SUBWF	ADREADPORT,W
	BTFSS	STATUS,2
	GOTO	SYSSELECT1CASE18
	BANKSEL	ANSELC
	BSF	ANSELC,0
	GOTO	SYSSELECTEND1
SYSSELECT1CASE18:
	MOVLW	17
	SUBWF	ADREADPORT,W
	BTFSS	STATUS,2
	GOTO	SYSSELECT1CASE19
	BANKSEL	ANSELC
	BSF	ANSELC,1
	GOTO	SYSSELECTEND1
SYSSELECT1CASE19:
	MOVLW	18
	SUBWF	ADREADPORT,W
	BTFSS	STATUS,2
	GOTO	SYSSELECT1CASE20
	BANKSEL	ANSELC
	BSF	ANSELC,2
	GOTO	SYSSELECTEND1
SYSSELECT1CASE20:
	MOVLW	19
	SUBWF	ADREADPORT,W
	BTFSS	STATUS,2
	GOTO	SYSSELECT1CASE21
	BANKSEL	ANSELC
	BSF	ANSELC,3
	GOTO	SYSSELECTEND1
SYSSELECT1CASE21:
	MOVLW	20
	SUBWF	ADREADPORT,W
	BTFSS	STATUS,2
	GOTO	SYSSELECT1CASE22
	BANKSEL	ANSELC
	BSF	ANSELC,4
	GOTO	SYSSELECTEND1
SYSSELECT1CASE22:
	MOVLW	21
	SUBWF	ADREADPORT,W
	BTFSS	STATUS,2
	GOTO	SYSSELECT1CASE23
	BANKSEL	ANSELC
	BSF	ANSELC,5
	GOTO	SYSSELECTEND1
SYSSELECT1CASE23:
	MOVLW	22
	SUBWF	ADREADPORT,W
	BTFSS	STATUS,2
	GOTO	SYSSELECT1CASE24
	BANKSEL	ANSELC
	BSF	ANSELC,6
	GOTO	SYSSELECTEND1
SYSSELECT1CASE24:
	MOVLW	23
	SUBWF	ADREADPORT,W
	BTFSS	STATUS,2
	GOTO	SYSSELECTEND1
	BANKSEL	ANSELC
	BSF	ANSELC,7
SYSSELECTEND1:
	BANKSEL	ADCON0
	BCF	ADCON0,4
	MOVLW	1
	MOVWF	ADCLK
	BCF	ADCON0,4
	MOVLW	15
	MOVWF	ADCLK
	BCF	ADCON0,2
	BCF	ADCON0,2
	BANKSEL	ADREADPORT
	MOVF	ADREADPORT,W
	BANKSEL	ADPCH
	MOVWF	ADPCH
	BANKSEL	ADCON0
	BSF	ADCON0,7
	MOVLW	2
	MOVWF	SYSWAITTEMP10US
	BANKSEL	STATUS
	CALL	DELAY_10US
	BANKSEL	ADCON0
	BSF	ADCON0,0
	NOP
SYSWAITLOOP1:
	BTFSC	ADCON0,0
	GOTO	SYSWAITLOOP1
	BCF	ADCON0,7
	BANKSEL	ANSELA
	CLRF	ANSELA
	CLRF	ANSELC
	BANKSEL	ADRESH
	MOVF	ADRESH,W
	BANKSEL	READAD
	MOVWF	READAD
	BANKSEL	ADCON0
	BCF	ADCON0,2
	BANKSEL	STATUS
	RETURN

;'********************************************************************************

SYSCOMPEQUAL16:
	CLRF	SYSBYTETEMPX
	MOVF	SYSWORDTEMPA, W
	SUBWF	SYSWORDTEMPB, W
	BTFSS	STATUS,2
	RETURN
	MOVF	SYSWORDTEMPA_H, W
	SUBWF	SYSWORDTEMPB_H, W
	BTFSS	STATUS,2
	RETURN
	COMF	SYSBYTETEMPX,F
	RETURN

;'********************************************************************************

SYSCOMPEQUAL32:
	CLRF	SYSBYTETEMPX
	MOVF	SYSLONGTEMPA, W
	SUBWF	SYSLONGTEMPB, W
	BTFSS	STATUS,2
	RETURN
	MOVF	SYSLONGTEMPA_H, W
	SUBWF	SYSLONGTEMPB_H, W
	BTFSS	STATUS,2
	RETURN
	MOVF	SYSLONGTEMPA_U, W
	SUBWF	SYSLONGTEMPB_U, W
	BTFSS	STATUS,2
	RETURN
	MOVF	SYSLONGTEMPA_E, W
	SUBWF	SYSLONGTEMPB_E, W
	BTFSS	STATUS,2
	RETURN
	COMF	SYSBYTETEMPX,F
	RETURN

;'********************************************************************************

SYSCOMPLESSTHAN16:
	CLRF	SYSBYTETEMPX
	MOVF	SYSWORDTEMPA_H,W
	SUBWF	SYSWORDTEMPB_H,W
	BTFSS	STATUS,0
	RETURN
	MOVF	SYSWORDTEMPB_H,W
	SUBWF	SYSWORDTEMPA_H,W
	BTFSS	STATUS,0
	GOTO	SCLT16TRUE
	MOVF	SYSWORDTEMPB,W
	SUBWF	SYSWORDTEMPA,W
	BTFSC	STATUS,0
	RETURN
SCLT16TRUE:
	COMF	SYSBYTETEMPX,F
	RETURN

;'********************************************************************************

SYSDIVSUB16:
	MOVF	SYSWORDTEMPA,W
	MOVWF	SYSDIVMULTA
	MOVF	SYSWORDTEMPA_H,W
	MOVWF	SYSDIVMULTA_H
	MOVF	SYSWORDTEMPB,W
	MOVWF	SYSDIVMULTB
	MOVF	SYSWORDTEMPB_H,W
	MOVWF	SYSDIVMULTB_H
	CLRF	SYSDIVMULTX
	CLRF	SYSDIVMULTX_H
	MOVF	SYSDIVMULTB,W
	MOVWF	SYSWORDTEMPA
	MOVF	SYSDIVMULTB_H,W
	MOVWF	SYSWORDTEMPA_H
	CLRF	SYSWORDTEMPB
	CLRF	SYSWORDTEMPB_H
	CALL	SYSCOMPEQUAL16
	BTFSS	SYSBYTETEMPX,0
	GOTO	ENDIF25
	CLRF	SYSWORDTEMPA
	CLRF	SYSWORDTEMPA_H
	RETURN
ENDIF25:
	MOVLW	16
	MOVWF	SYSDIVLOOP
SYSDIV16START:
	BCF	STATUS,0
	RLF	SYSDIVMULTA,F
	RLF	SYSDIVMULTA_H,F
	RLF	SYSDIVMULTX,F
	RLF	SYSDIVMULTX_H,F
	MOVF	SYSDIVMULTB,W
	SUBWF	SYSDIVMULTX,F
	MOVF	SYSDIVMULTB_H,W
	SUBWFB	SYSDIVMULTX_H,F
	BSF	SYSDIVMULTA,0
	BTFSC	STATUS,0
	GOTO	ENDIF26
	BCF	SYSDIVMULTA,0
	MOVF	SYSDIVMULTB,W
	ADDWF	SYSDIVMULTX,F
	MOVF	SYSDIVMULTB_H,W
	ADDWFC	SYSDIVMULTX_H,F
ENDIF26:
	DECFSZ	SYSDIVLOOP, F
	GOTO	SYSDIV16START
	MOVF	SYSDIVMULTA,W
	MOVWF	SYSWORDTEMPA
	MOVF	SYSDIVMULTA_H,W
	MOVWF	SYSWORDTEMPA_H
	MOVF	SYSDIVMULTX,W
	MOVWF	SYSWORDTEMPX
	MOVF	SYSDIVMULTX_H,W
	MOVWF	SYSWORDTEMPX_H
	RETURN

;'********************************************************************************

SYSDIVSUB32:
	MOVF	SYSLONGTEMPA,W
	MOVWF	SYSLONGDIVMULTA
	MOVF	SYSLONGTEMPA_H,W
	MOVWF	SYSLONGDIVMULTA_H
	MOVF	SYSLONGTEMPA_U,W
	MOVWF	SYSLONGDIVMULTA_U
	MOVF	SYSLONGTEMPA_E,W
	MOVWF	SYSLONGDIVMULTA_E
	MOVF	SYSLONGTEMPB,W
	MOVWF	SYSLONGDIVMULTB
	MOVF	SYSLONGTEMPB_H,W
	MOVWF	SYSLONGDIVMULTB_H
	MOVF	SYSLONGTEMPB_U,W
	MOVWF	SYSLONGDIVMULTB_U
	MOVF	SYSLONGTEMPB_E,W
	MOVWF	SYSLONGDIVMULTB_E
	CLRF	SYSLONGDIVMULTX
	CLRF	SYSLONGDIVMULTX_H
	CLRF	SYSLONGDIVMULTX_U
	CLRF	SYSLONGDIVMULTX_E
	MOVF	SYSLONGDIVMULTB,W
	MOVWF	SYSLONGTEMPA
	MOVF	SYSLONGDIVMULTB_H,W
	MOVWF	SYSLONGTEMPA_H
	MOVF	SYSLONGDIVMULTB_U,W
	MOVWF	SYSLONGTEMPA_U
	MOVF	SYSLONGDIVMULTB_E,W
	MOVWF	SYSLONGTEMPA_E
	CLRF	SYSLONGTEMPB
	CLRF	SYSLONGTEMPB_H
	CLRF	SYSLONGTEMPB_U
	CLRF	SYSLONGTEMPB_E
	CALL	SYSCOMPEQUAL32
	BTFSS	SYSBYTETEMPX,0
	GOTO	ENDIF14
	CLRF	SYSLONGTEMPA
	CLRF	SYSLONGTEMPA_H
	CLRF	SYSLONGTEMPA_U
	CLRF	SYSLONGTEMPA_E
	RETURN
ENDIF14:
	MOVLW	32
	MOVWF	SYSDIVLOOP
SYSDIV32START:
	BCF	STATUS,0
	RLF	SYSLONGDIVMULTA,F
	RLF	SYSLONGDIVMULTA_H,F
	RLF	SYSLONGDIVMULTA_U,F
	RLF	SYSLONGDIVMULTA_E,F
	RLF	SYSLONGDIVMULTX,F
	RLF	SYSLONGDIVMULTX_H,F
	RLF	SYSLONGDIVMULTX_U,F
	RLF	SYSLONGDIVMULTX_E,F
	MOVF	SYSLONGDIVMULTB,W
	SUBWF	SYSLONGDIVMULTX,F
	MOVF	SYSLONGDIVMULTB_H,W
	SUBWFB	SYSLONGDIVMULTX_H,F
	MOVF	SYSLONGDIVMULTB_U,W
	SUBWFB	SYSLONGDIVMULTX_U,F
	MOVF	SYSLONGDIVMULTB_E,W
	SUBWFB	SYSLONGDIVMULTX_E,F
	BSF	SYSLONGDIVMULTA,0
	BTFSC	STATUS,0
	GOTO	ENDIF15
	BCF	SYSLONGDIVMULTA,0
	MOVF	SYSLONGDIVMULTB,W
	ADDWF	SYSLONGDIVMULTX,F
	MOVF	SYSLONGDIVMULTB_H,W
	ADDWFC	SYSLONGDIVMULTX_H,F
	MOVF	SYSLONGDIVMULTB_U,W
	ADDWFC	SYSLONGDIVMULTX_U,F
	MOVF	SYSLONGDIVMULTB_E,W
	ADDWFC	SYSLONGDIVMULTX_E,F
ENDIF15:
	DECFSZ	SYSDIVLOOP, F
	GOTO	SYSDIV32START
	MOVF	SYSLONGDIVMULTA,W
	MOVWF	SYSLONGTEMPA
	MOVF	SYSLONGDIVMULTA_H,W
	MOVWF	SYSLONGTEMPA_H
	MOVF	SYSLONGDIVMULTA_U,W
	MOVWF	SYSLONGTEMPA_U
	MOVF	SYSLONGDIVMULTA_E,W
	MOVWF	SYSLONGTEMPA_E
	MOVF	SYSLONGDIVMULTX,W
	MOVWF	SYSLONGTEMPX
	MOVF	SYSLONGDIVMULTX_H,W
	MOVWF	SYSLONGTEMPX_H
	MOVF	SYSLONGDIVMULTX_U,W
	MOVWF	SYSLONGTEMPX_U
	MOVF	SYSLONGDIVMULTX_E,W
	MOVWF	SYSLONGTEMPX_E
	RETURN

;'********************************************************************************

SYSSTRINGTABLES:
	MOVF	SYSSTRINGA_H,W
	MOVWF	PCLATH
	MOVF	SYSSTRINGA,W
	INCF	SYSSTRINGA,F
	BTFSC	STATUS,2
	INCF	SYSSTRINGA_H,F
	MOVWF	PCL

STRINGTABLE5:
	RETLW	39
	RETLW	73	;I
	RETLW	68	;D
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	RETLW	67	;C
	RETLW	49	;1
	RETLW	54	;6
	RETLW	70	;F
	RETLW	49	;1
	RETLW	56	;8
	RETLW	52	;4
	RETLW	50	;2
	RETLW	52	;4
	RETLW	32	; 
	RETLW	70	;F
	RETLW	87	;W
	RETLW	61	; (EQUALS)
	RETLW	48	;0
	RETLW	46	;.
	RETLW	49	;1
	RETLW	46	;.
	RETLW	49	;1


STRINGTABLE6:
	RETLW	12
	RETLW	83	;S
	RETLW	84	;T
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	RETLW	89	;Y


STRINGTABLE7:
	RETLW	20
	RETLW	79	;O
	RETLW	75	;K
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	RETLW	78	;N


STRINGTABLE8:
	RETLW	21
	RETLW	79	;O
	RETLW	75	;K
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	RETLW	78	;N


STRINGTABLE9:
	RETLW	12
	RETLW	68	;D
	RETLW	65	;A
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	RETLW	32	; 


STRINGTABLE10:
	RETLW	5
	RETLW	32	; 
	RETLW	65	;A
	RETLW	68	;D
	RETLW	67	;C
	RETLW	32	; 


;'********************************************************************************

;'PROGRAM_MEMORY_PAGE: 1
	PSECT	PROGMEM1,CLASS=CODE,SPACE=SPACE_CODE,DELTA=2, ABS, OVRLD 
	ORG	2048
;'
;' Declare Power-On-Reset entry point
;'
 END     RESETVEC
